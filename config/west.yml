## config/west.yml
```yaml
manifest:
  remotes:
    - name: zmkfirmware
      url-base: https://github.com/zmkfirmware
    - name: tokyo2006
      url-base: https://github.com/tokyo2006
    - name: englmaxi
      url-base: https://github.com/englmaxi
    - name: infely
      url-base: https://github.com/infely
    - name: joaopedropio
      url-base: https://github.com/joaopedropio
  projects:
    - name: zmk
      remote: zmkfirmware
      revision: main
      import: app/west.yml
    - name: prospector-zmk-module                 # <--- and these
      remote: tokyo2006                          # <---
      revision: micro_spi2  
    - name: zmk-dongle-display
      remote: englmaxi
      revision: main
    - name: nice-view-battery
      remote: infely
      revision: main
    - name: snake-module
      remote: joaopedropio
      revision: master
  self:
    path: config
```
